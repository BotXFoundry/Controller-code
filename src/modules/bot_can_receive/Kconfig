## src/modules/bot_can_receive/Kconfig
```kconfig
menuconfig MODULES_BOT_CAN_RECEIVE
	bool "bot_can_receive"
	default n
	---help---
		Enable support for bot_can_receive
```

## src/modules/bot_com_handler/Kconfig
```kconfig
menuconfig MODULES_BOT_COM_HANDLER
	bool "bot_com_handler"
	default n
	---help---
		Enable support for bot_com_handler
```

## src/modules/bot_motion_control/Kconfig
```kconfig
menuconfig MODULES_BOT_MOTION_CONTROL
	bool "bot_motion_control"
	default n
	---help---
		Enable support for bot_motion_control
```

## src/modules/bot_rc/Kconfig
```kconfig
menuconfig MODULES_BOT_RC
	bool "bot_rc"
	default n
	---help---
		Enable support for bot_rc
```

## src/modules/bot_sensor/Kconfig
```kconfig
menuconfig MODULES_BOT_SENSOR
	bool "bot_sensor"
	default n
	---help---
		Enable support for bot_sensor
```

## src/modules/bot_ultrasonic/Kconfig
```kconfig
menuconfig MODULES_BOT_ULTRASONIC
	bool "bot_ultrasonic"
	default n
	---help---
		Enable support for bot_ultrasonic
```
